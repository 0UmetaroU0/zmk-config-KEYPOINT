## config/west.yml
```yaml
manifest:
  remotes:
    - name: cormoran
      url-base: https://github.com/cormoran

  projects:
    - name: zmk-module-runtime-input-processor
      remote: cormoran
      revision: zmk-v0.3.0.0

    - name: zmk-feature-custom-settings
      url: https://github.com/0UmetaroU0/zmk-feature-custom-settings-v03
      revision: v0.3-port

    - name: zmk-feature-runtime-macro
      url: https://github.com/0UmetaroU0/zmk-feature-runtime-macro-v03
      revision: e98d1eb33be63f4679356a96f1732aad84a7ac44

    - name: zmk
      remote: cormoran
      revision: v0.3+custom-studio-protocol
      import:
        file: app/west.yml

  self:
    path: config
```
